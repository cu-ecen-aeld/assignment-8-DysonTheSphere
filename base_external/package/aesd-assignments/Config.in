## base_external/package/aesd-assignments/Config.in
```kconfig
config BR2_PACKAGE_AESD_ASSIGNMENTS
	bool "aesd-assignments"
	help
	  Includes the writer executable, finder.sh, tester.sh, and aesdchar driver.
	  Used to understand buildroot external trees and package builds.
```
